## drivers/techsafe_utilities/Kconfig
```kconfig
# Keyboard scan configuration options

# Copyright (c) 2019 Intel Corporation
# SPDX-License-Identifier: Apache-2.0

menuconfig TECHSAFE_UTILITIES
	bool "Techsafe Utility Settings"
	help
	  Include Techsafe Utility Settings in system config.

if TECHSAFE_UTILITIES


module = TECHSAFE_UTILITIES
module-str = techsafe_utilities
source "subsys/logging/Kconfig.template.log_config"

config TECHSAFE_UTILITIES_INIT_PRIORITY
	int "TECHSAFE_UTILITIES init priority"
	default 50
	help
	  TECHSAFE_UTILITIES initialization priority.

endif # TECHSAFE_UTILITIES
```

## dts/bindings/techsafe_utilities/techsafe,application.yaml
```yaml
description: Application bus
compatible: "techsafe,application"
include: base.yaml
bus: application
```

## dts/bindings/techsafe_utilities/techsafe,fb-add.yaml
```yaml
description: Add function block definition
compatible: "techsafe,fb-add"
include: base.yaml
on-bus: application
bus: function

properties:
  input1:
    type: phandle
    description: Input 1
    required: false
  input2:
    type: phandle
    description: Input 2
    required: false
  output:
    type: phandle
    description: Output
    required: false
```

## dts/bindings/techsafe_utilities/techsafe,port-cbor.yaml
```yaml
description: CBOR type port definition
compatible: "techsafe,port-cbor"
include: base.yaml
on-bus: function

properties:
  initial-value:
    type: uint8-array
    description: CBOR value
    required: false
```

## dts/bindings/techsafe_utilities/techsafe,port-int.yaml
```yaml
description: Integer type port definition

compatible: "techsafe,port-int"

include: base.yaml

properties:
  port-name:
    type: string
    description: Name of the port
    required: true
  port-value:
    type: int
    description: Port value
    required: true
```
